## examples/esp32c3_6/burst/sdkconfig.defaults.esp32c3
```kconfig
CONFIG_LORA_ROLE_SENDER=y
CONFIG_LORA_PIN_NSS=3
CONFIG_LORA_PIN_SCK=0
CONFIG_LORA_PIN_MISO=1
CONFIG_LORA_PIN_MOSI=2
CONFIG_ESP_MAIN_TASK_STACK_SIZE=8192
```

## examples/esp32c3_6/burst/sdkconfig.defaults.esp32c6
```kconfig
CONFIG_LORA_PIN_NSS=18
CONFIG_LORA_PIN_SCK=14
CONFIG_LORA_PIN_MISO=3
CONFIG_LORA_PIN_MOSI=4
```

## examples/esp32c3_6/pingpong/main/Kconfig.projbuild
```kconfig
menu "LoRa Hardware Config"

    choice LORA_ROLE
        prompt "Device role"
        default LORA_ROLE_SENDER
        config LORA_ROLE_SENDER
            bool "Sender"
        config LORA_ROLE_RECEIVER
            bool "Receiver"
    endchoice

    config LORA_PIN_NSS
        int "NSS (CS) GPIO number"
        default 3

    config LORA_PIN_SCK
        int "SCK GPIO number"
        default 0

    config LORA_PIN_MISO
        int "MISO GPIO number"
        default 1

    config LORA_PIN_MOSI
        int "MOSI GPIO number"
        default 2

endmenu
```

## examples/esp32c3_6/pingpong/sdkconfig.defaults.esp32c3
```kconfig
CONFIG_LORA_PIN_NSS=3
CONFIG_LORA_PIN_SCK=0
CONFIG_LORA_PIN_MISO=1
CONFIG_LORA_PIN_MOSI=2
```

## examples/esp32c3_6/pingpong/sdkconfig.defaults.esp32c3.receiver
```kconfig
CONFIG_LORA_ROLE_RECEIVER=y
CONFIG_LORA_PIN_NSS=3
CONFIG_LORA_PIN_SCK=0
CONFIG_LORA_PIN_MISO=1
CONFIG_LORA_PIN_MOSI=2
```

## examples/esp32c3_6/pingpong/sdkconfig.defaults.esp32c6
```kconfig
CONFIG_LORA_ROLE_RECEIVER=y
CONFIG_LORA_PIN_NSS=18
CONFIG_LORA_PIN_SCK=14
CONFIG_LORA_PIN_MISO=3
CONFIG_LORA_PIN_MOSI=4
```
